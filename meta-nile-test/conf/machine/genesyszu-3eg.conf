## meta-nile-test/conf/machine/genesyszu-3eg.conf
```bitbake
#@TYPE: Machine
#@NAME: genesyszu-3eg
#@DESCRIPTION: Machine support for Digilent Genesys ZU 3EG

#### Preamble
MACHINEOVERRIDES =. "${@['', 'genesyszu-3eg:']['genesyszu-3eg' !='${MACHINE}']}"
#### Regular settings follow

BBMULTICONFIG += "genesyszu-3eg-cortexa53-fsbl genesyszu-3eg-microblaze-pmu"
TUNEFILE[microblaze-pmu] = "conf/machine/include/genesyszu-3eg/microblaze.inc"

FSBL_DEPENDS = ""
FSBL_MCDEPENDS = "mc::genesyszu-3eg-cortexa53-fsbl:fsbl-firmware:do_deploy"
FSBL_DEPLOY_DIR = "${TMPDIR}-genesyszu-3eg-cortexa53-fsbl/deploy/images/${MACHINE}"

PMU_DEPENDS = ""
PMU_MCDEPENDS = "mc::genesyszu-3eg-microblaze-pmu:pmu-firmware:do_deploy"
PMU_FIRMWARE_DEPLOY_DIR = "${TMPDIR}-genesyszu-3eg-microblaze-pmu/deploy/images/${MACHINE}"

CONFIG_DTFILE_DIR := "${@bb.utils.which(d.getVar('BBPATH'), 'conf/dts/genesyszu-3eg')}"
CONFIG_DTFILE ?= "${CONFIG_DTFILE_DIR}/cortexa53-linux.dts"
CONFIG_DTFILE[vardepsexclude] += "CONFIG_DTFILE_DIR"

SERIAL_CONSOLES ?= "115200;ttyPS0"
TFA_CONSOLE ?= "cadence"
TFA_BL33_LOAD ?= "0x8000000"

ZYNQMP_SUBMODEL = "-eg"

require conf/machine/genesyszu.inc

XILINX_WITH_ESW = "sdt"
SDT_URI = "git://github.com/Digilent/sdt.git;protocol=https;branch=zu/3eg/genesyszu/main;rev=c3561915c1c8619ab2d9b72ac9649090768f83fd"
SDT_URI[S] = "${WORKDIR}/git/generated/sdt"

SYSTEM_DTFILE_DEPENDS = "sdt-artifacts"
SYSTEM_DTFILE_DIR = "${RECIPE_SYSROOT}${datadir}/sdt/${MACHINE}"
SYSTEM_DTFILE = "${SYSTEM_DTFILE_DIR}/system-top.dts"

include conf/machine/include/genesyszu-3eg/${BB_CURRENT_MC}-features.conf
LIBXIL_CONFIG = "conf/machine/include/genesyszu-3eg/${BB_CURRENT_MC}-libxil.conf"

BITSTREAM_PATH_DEPENDS = "sdt-artifacts"
BITSTREAM_PATH_DIR = "${SYSTEM_DTFILE_DIR}"
BITSTREAM_PATH = "${BITSTREAM_PATH_DIR}/system_wrapper.bit"

DEFAULT_HW_BOOT_MODE = "3"
BIF_PARTITION_IMAGE[device-tree] = "${RECIPE_SYSROOT}/boot/devicetree/${@os.path.basename(d.getVar('CONFIG_DTFILE').replace('.dts', '.dtb'))}"
IMAGE_BOOT_FILES =+ "devicetree/${@os.path.basename(d.getVar('CONFIG_DTFILE').replace('.dts', '.dtb'))}"

### No additional settings should be after the Postamble
#### Postamble
PACKAGE_EXTRA_ARCHS:append = "${@['', ' genesyszu-3eg']['genesyszu-3eg' != '${MACHINE}']}"
```

## meta-nile-test/conf/machine/include/genesyszu-3eg/genesyszu-3eg-cortexa53-fsbl-features.conf
```bitbake
MACHINE_FEATURES = "avbuf axipmon clockps common coresightps-dcc csudma ddrcpsu dpdma dppsu emacps gpiops iicps ipipsu pciepsu qspipsu resetps rtcpsu scugic sdps spips sysmonpsu ttcps uartps usbpsu video-common zdma"
```

## meta-nile-test/conf/machine/include/genesyszu-3eg/genesyszu-3eg-microblaze-pmu-features.conf
```bitbake
MACHINE_FEATURES = "avbuf axipmon clockps common csudma ddrcpsu dpdma dppsu emacps gpiops iicps ipipsu pciepsu qspipsu resetps rtcpsu sdps spips sysmonpsu ttcps uartps usbpsu video-common zdma"
```

## meta-nile/conf/machine/amd-cortexa9thf-neon-common.conf
```bitbake
#@TYPE: Machine
#@NAME: amd-cortexa9thf-neon-common
#@DESCRIPTION: Generic AMD Zynq machine for Cortex-A9 hard-float NEON targets

MACHINEOVERRIDES =. "${@['', 'amd-cortexa9thf-neon-common:']['amd-cortexa9thf-neon-common' != '${MACHINE}']}"

DEFAULTTUNE = "cortexa9thf-neon"

require conf/machine/zynq-generic.conf

QB_CMDLINE_IP_SLIRP = ""
QB_CMDLINE_IP_TAP = ""
QB_DEFAULT_KERNEL = ""
QB_DTB = ""
QB_MACHINE = ""
QB_MEM = ""
QB_NETWORK_DEVICE = ""
QB_NO_PNI = ""
QB_OPT_APPEND = ""
QB_ROOTFS_OPT = ""
QB_SERIAL_OPT = ""

MACHINE_FEATURES += "fpga-overlay"

PACKAGE_EXTRA_ARCHS:append = "${@['', ' amd_cortexa9thf_neon_common']['amd-cortexa9thf-neon-common' != "${MACHINE}"]}"
```
